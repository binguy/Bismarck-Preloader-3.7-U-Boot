## src/template/Phoebus_spi_nand_auth/img.its
```
/*
 * U-Boot uImage source file with multiple kernels, ramdisks and FDT blobs
 */

/dts-v1/;

/ {
	description = "OTTO";
	#address-cells = <1>;

	images {
		preloader {
			description = "plr";
			type = "standalone";
			arch = "mips";
			data = /incbin/("../../../release/plr.img");
			compression = "none";
			load = <0x9f000000>;
			entry = <0x9f000000>;
		};
		uboot {
			description = "uboot";
			type = "standalone";
			arch = "mips";
			data = /incbin/("../../../uboot_v2020.01/u-boot.pimg");
			compression = "lzma";
			sign = /incbin/("../../../release/signature");
			load = <0x80000000>;
			entry = <0x80000000>;
		};
	};
};
```

## util/todaro_verified_boot/apro_03cvd_verified_boot.its
```
/dts-v1/;
/ {
    description = "fitImage for RTK APro & RTL9603C-VD Kernel";
    #address-cells = <0x1>;
    images {
        kernel@0 {
            description = "Linux Kernel";
            data = /incbin/("./kernel_image/vmlinux.bin.lzma");
            type = "kernel";
            arch = "MIPS";
            os = "linux";
            compression = "lzma";
            load = <0x80010000>;
            entry = <0x808862a0>;
            hash@1 {
                algo = "sha1";
            };
            signature@0 {
                algo = "sha1,rsa2048";
                key-name-hint = "dev";
            };
        };
        script@0 {
            description = "Script";
            data = /incbin/("./kernel_image/uboot_verity_script");
            type = "script";
            compression = "none";
            hash@0 {
                algo = "sha1";
            };
            signature@0 {
                algo = "sha1,rsa2048";
                key-name-hint = "dev";
            };
        };
    };

    configurations {
        default = "conf@1";
        conf@1 {
            description = "Boot Linux kernel with FDT blob ";
            kernel = "kernel@0";
            script = "script@0";
            hash@1 {
                algo = "sha1";
            };
            signature@1 {
                algo = "sha1,rsa2048";
                key-name-hint = "dev";
                sign-images = "kernel", "script";
            };
        };
    };
};
```

## util/todaro_verified_boot/vd2_verified_boot.its
```
/dts-v1/;
/ {
    description = "fitImage for VD2 Kernel";
    #address-cells = <0x1>;
    images {
        kernel@0 {
            description = "Linux Kernel";
            data = /incbin/("./kernel_image/linux.bin.lzma");
            type = "kernel";
            arch = "MIPS";
            os = "linux";
            compression = "lzma";
            load = <0x80000000>;
            entry = <0x80000000>;
            hash@1 {
                algo = "sha1";
            };
            signature@0 {
                algo = "sha1,rsa2048";
                key-name-hint = "dev";
            };
        };
    };

    configurations {
        default = "conf@1";
        conf@1 {
            description = "Boot Linux kernel with FDT blob ";
            kernel = "kernel@0";
            hash@1 {
                algo = "sha1";
            };
            signature@1 {
                algo = "sha1,rsa2048";
                key-name-hint = "dev";
                sign-images = "kernel";
            };
        };
    };
};
```
